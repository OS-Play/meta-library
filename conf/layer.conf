## conf/layer.conf
```bitbake
# We have a conf and classes directory, add to BBPATH
BBPATH .= ":${LAYERDIR}"

# We have recipes-* directories, add to BBFILES
BBFILES += "${LAYERDIR}/recipes-*/*/*.bb \
            ${LAYERDIR}/recipes-*/*/*.bbappend"

BBFILE_COLLECTIONS += "meta-library"
BBFILE_PATTERN_meta-library = "^${LAYERDIR}/"
BBFILE_PRIORITY_meta-library = "6"

LAYERDEPENDS_meta-library = "core"
LAYERSERIES_COMPAT_meta-library = "kirkstone"
```
